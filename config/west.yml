## config/west.yml
```yaml
manifest:
  remotes:
    - name: zmkfirmware
      url-base: https://github.com/krikun98
  projects:
    - name: zmk
      remote: zmkfirmware
      revision: mousekp-behavior
      import: app/west.yml
  self:
    path: config
```
